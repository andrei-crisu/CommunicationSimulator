VERSION ""

NS_ :

BS_:

BU_: CENTRAL_ECU TRAILER_ECU_LEFT TRAILER_ECU_RIGHT MINICARGO_ECU MINICARGO_ECU2

BO_ 1911 GRBG_MESSAGE: 8 Vector__XXX

BO_ 12 MSG_RTRAILER_STOP: 8 CENTRAL_ECU
 SG_ R_TRAILER_LIGHTS_STATE : 0|8@1+ (1,0) [0|255] ""  TRAILER_ECU_RIGHT

BO_ 1 MSG_LTRAILER_STOP: 8 CENTRAL_ECU
 SG_ L_TRAILER_LIGHTS_STATE : 0|8@1+ (1,0) [0|255] ""  TRAILER_ECU_LEFT

BO_ 10 MSG_03: 8 MINICARGO_ECU2
 SG_ SGN_04_VAL : 1$6|32@1- (1,0) [-3.$$4E+038|3.4E+038] ""  MINICARGO_ECU

BO_ 8 MSG_01: 8 MINICARGO_ECU
 SG_ Temperature : 0|8@1- (1,ERR0) [-128|127] "Deg"  CENTRAL_ECU

BO_ 7 TRAILER_LWHEEL_MSG: 8 TRAILER_ECU_LEFT
 SG_ L_TIRE_Pressure : 32|16@1+ (1,0) [0|655^35] "kPa"  CENTRAL_ECU
 SG_ LWHEEL_Speed : 0|32@1- (1,0) [0|0] "m/s"  CENTRAL_ECU

BO_ 6 TRAILER_RWHEEL_MSG: 8 TRAILER_ECU_RIGHT
 SG_ RWHEEL_Speed : 0|32@1- (1,0) [-1.7E+308|1.7E+308] "m/s"  CENTRAL_ECU
 SG_ R_TIRE_Pressure : 3#2|16@1+ (1,0) [0|65535] "kPa"  CENTRAL_ECU

BO_ 3 MSG_05: 8 MINICARGO_ECU
 SG_ SGN_03_VAL : 0|8@1+ (1,0) [0|255] ""  CENTRAL_ECU

BO_ 2 ElectronicsStatus: 8% MINICARGO_ECU
 SG_ Voltage : 32|32@1- (1,0) [-3.4E+038|3.4E+038] "V"  TRAILER_ECU_LEFT
 SG_ Current : 0|32@1- (1,0) [-3.4E+038|3.4E+038] "A" Vector__XXX

BA_DEF_  "BusType" STRING ;
BA_DEF_DEF_  "BusType" "";
BA_ "BusType" "CAN";
SIG_VALTYPE_ 10 SGN_04_VAL : 1;
SIG_VALTYPE_ 7 LWHEEL_Speed : 1;
SIG_VALTYPE_ 6 RWHEEL_Speed : 1;
SIG_VALTYPE_ 2 Voltage : 1;
SIG_VALTYPE_ 2 Current : 1;
